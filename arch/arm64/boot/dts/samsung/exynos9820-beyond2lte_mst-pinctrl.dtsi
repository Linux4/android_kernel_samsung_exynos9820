/* Copyright (c) 2013, Samsung Electronics Corporation. All rights reserved.
 *
 * This program is free software; you can redistribute it and/or modify
 * it under the terms of the GNU General Public License version 2 and
 * only version 2 as published by the Free Software Foundation.
 *
 * This program is distributed in the hope that it will be useful,
 * but WITHOUT ANY WARRANTY; without even the implied warranty of
 * MERCHANTABILITY or FITNESS FOR A PARTICULAR PURPOSE.  See the
 * GNU General Public License for more details.
 */

&pinctrl_6 {
	mst_pwr_en: sec-mst,mst-pwr-gpio {
		samsung,pins ="gpg3-5";
		samsung,pin-function = <1>;
		samsung,pin-pud = <1>;
	};

	mst_en: sec-mst,mst-en-gpio {
		samsung,pins ="gpp4-5";
		samsung,pin-function = <1>;
		samsung,pin-pud = <1>;
	};

	mst_data: sec-mst,mst-data-gpio {
		samsung,pins ="gpp4-4";
		samsung,pin-function = <1>;
		samsung,pin-pud = <1>;
	};
};
